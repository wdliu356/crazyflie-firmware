## configs/bolt_defconfig
```kconfig
CONFIG_PLATFORM_BOLT=y

CONFIG_ESTIMATOR_AUTO_SELECT=y
CONFIG_CONTROLLER_AUTO_SELECT=y

CONFIG_MOTORS_REQUIRE_ARMING=n
CONFIG_DECK_FORCE="bcServo"
CONFIG_DECK_SERVO=y

CONFIG_DECK_SERVO_USE_IO2=y
```
